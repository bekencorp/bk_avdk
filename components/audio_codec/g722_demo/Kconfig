## components/audio_codec/g722_demo/Kconfig
```kconfig
menu "Demos::Media::Audio::G711"
	config AUDIO_G722_TEST
		bool "Enable Audio G722 Test"
		default n
endmenu
```

## components/bk_draw_blend/Kconfig
```kconfig
menu "Draw Blend"

	config BLEND
		depends on SYS_CPU1
        depends on MEDIA
		bool "Enable Draw Blend"
		default y
endmenu
```

## components/bk_peripheral/src/lcd/spi/Kconfig
```kconfig
menu "SPI LCD"

	config LCD_SPI_ST7796U
		bool "Enable LCD_SPI_ST7796U"
		default n

	config LCD_SPI_GC9D01
		bool "Enable LCD_SPI_GC9D01"
		default n
endmenu
```

## components/bk_thirdparty/asr/wanson/Kconfig
```kconfig
menu "Bk_thirdparty::Wanson"

	config WANSON_ASR
		bool "Enable Wanson ASR"
		default n
		help
			Enable Wanson Automatic Speech Recognition

	choice WANSON_ASR_WORDS_VERSION
		depends on WANSON_ASR
		prompt "Select Words Version"
		default WANSON_ASR_WORDS_VERSION_V1

		config WANSON_ASR_WORDS_VERSION_V1
		bool "Enable Words Version V1"
		help
			support wakeword "a er mi nuo"

		config WANSON_ASR_WORDS_VERSION_V2
		bool "Enable Words Version V2"
		help
			support wakeword "hi armino"
	endchoice

endmenu
```

## components/bk_thirdparty/asr/wenwen/Kconfig
```kconfig
menu "Bk_thirdparty::WenWen"

	config WENWEN_ASR
		bool "Enable WenWen ASR"
		default n
		help
			Enable WenWen Automatic Speech Recognition

	choice WENWEN_ASR_VERSION
		depends on WENWEN_ASR
		prompt "Select WenWen ASR Version"
		default WENWEN_ASR_VERSION_SINGLE_MIC

		config WENWEN_ASR_VERSION_SINGLE_MIC
			bool "Enable WenWen ASR Single Mic Version"
			help
				WenWen ASR only need one mic data

		config WENWEN_ASR_VERSION_DUAL_MIC
			bool "Enable WenWen ASR Dual Mic Version"
			help
				WenWen ASR only need two mic data
	endchoice

endmenu
```

## components/display_service/Kconfig
```kconfig
menu "Display Service"

	config MEDIA_DISPLAY_SERVICE
		depends on SYS_CPU1
		bool "Enable Display Service"
		default y

	config LCD_SPI_DISPLAY
		depends on SPI
		bool "Enable LCD SPI Display"
		default n

	config LCD_SPI_DEVICE_NUM
		depends on LCD_SPI_DISPLAY
		int "Set lcd spi device number"
		default 1

	config LCD_EXAMPLE
		depends on SPI
		bool "Enable LCD SPI Display"
		default n
endmenu
```

## components/media_utils/Kconfig
```kconfig
menu "Media Utils"

	config MEDIA_IPC
		depends on MAILBOX
		bool "Enable Media"
		default y
		help
			Enable media ipc

	config PSRAM_MEM_SLAB_USER_SIZE
		depends on PSRAM
		int "size of psram user need to use"
		default 102400

	config PSRAM_MEM_SLAB_AUDIO_SIZE
		depends on PSRAM
		int "size of psram audio need to use"
		default 102400

	config PSRAM_MEM_SLAB_ENCODE_SIZE
		depends on PSRAM
		int "size of psram encode function need to use"
		default 1433600

	config PSRAM_MEM_SLAB_DISPLAY_SIZE
		depends on PSRAM
		int "size of psram display need to use"
		default 5701632

	config PSRAM_MEDIA_MALLOC_ENABLE
		depends on PSRAM_AS_SYS_MEMORY
		bool "multimedia function use malloc psram as mem"
		default y

	config MEDIA_DEBUG_TIMER_ENABLE
		depends on MEDIA
		bool "enable software timer to printf some camera info"
		default y
endmenu
```

## projects/lvgl/camera/main/Kconfig.projbuild
```kconfig
menu "LVGL Meter Configuration"

    config INTEGRATION_DOORBELL
        bool "Doorbell integration"
        default n

    config INTEGRATION_DOORBELL_CS2
        bool "Doorbell integration CS2"
        default n

    config LV_USE_DEMO_METER
        bool "LVGL Meter"
        default n
endmenu
```

## projects/media/av_server/main/Kconfig.projbuild
```kconfig
menu "dual_device_transmission"

	choice AV_DEMO_MODE
		prompt "Select Av Demo Mode"
		default AV_DEMO_MODE_UDP

		config AV_DEMO_MODE_UDP
			bool "AV_DEMO_MODE_UDP"
			help
				AV demo work in UDP mode

		config AV_DEMO_MODE_TCP
			bool "AV_DEMO_MODE_TCP"
			help
				AV demo work in TCP mode

	endchoice
endmenu
```

## projects/media/doorbell/main/Kconfig.projbuild
```kconfig
menu "INTEGRATION_DOORBELL"

    config INTEGRATION_DOORBELL
        bool "Doorbell integration"
        default n
    config INTEGRATION_DOORBELL_CS2
        bool "Doorbell integration CS2"
        default n

    config BLEND_UI
        depends on BLEND
        bool "Enable Blend UI"
        default n
endmenu
```

## projects/media/doorbell_4M/main/Kconfig.projbuild
```kconfig
menu "INTEGRATION_DOORBELL"

    config INTEGRATION_DOORBELL
        bool "Doorbell integration"
        depends on MEDIA
        default n
    config INTEGRATION_DOORBELL_CS2
        bool "Doorbell integration CS2"
        depends on MEDIA
        default n
		
endmenu
```
